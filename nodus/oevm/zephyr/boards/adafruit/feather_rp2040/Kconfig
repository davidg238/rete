## nodus/oevm/zephyr/boards/adafruit/feather_rp2040/Kconfig.defconfig
```kconfig
# Copyright (c) 2026 Ekorau LLC
# SPDX-License-Identifier: Apache-2.0

if BOARD_ADAFRUIT_FEATHER_RP2040

config USB_SELF_POWERED
	default n

endif # BOARD_ADAFRUIT_FEATHER_RP2040
```

## nodus/oevm/zephyr/boards/weact/rp2350b_core/Kconfig.defconfig
```kconfig
# Copyright (c) 2026 Ekorau LLC
# SPDX-License-Identifier: Apache-2.0

if BOARD_WEACT_RP2350B_CORE

config USB_SELF_POWERED
	default n

endif # BOARD_WEACT_RP2350B_CORE
```

## nodus/oevm/zephyr/boards/weact/rp2350b_core/Kconfig.weact_rp2350b_core
```kconfig
# Copyright (c) 2026 Ekorau LLC
# SPDX-License-Identifier: Apache-2.0

config BOARD_WEACT_RP2350B_CORE
	select SOC_RP2350B_M33 if BOARD_WEACT_RP2350B_CORE_RP2350B_M33
```

## nodus/oevm/zephyr/boards/weact/rp2350b_core/board.yml
```yaml
board:
  name: weact_rp2350b_core
  full_name: WeAct Studio RP2350B Core Board
  vendor: weact
  socs:
  - name: rp2350b
```
