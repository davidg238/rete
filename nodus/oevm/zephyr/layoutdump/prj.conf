## CMakeLists.txt
```
cmake_minimum_required(VERSION 3.20.0)
# Out-of-tree boards under zephyr/boards/<vendor>/<board>/ — the Adafruit Feather
# RP2040 (rete#302's rehearsal board, absent from Zephyr v4.2). Must precede
# find_package(Zephyr); the same directory keeps holding the per-board .overlay
# files, which Zephyr discovers by a different rule.
list(APPEND BOARD_ROOT ${CMAKE_CURRENT_SOURCE_DIR}/..)
find_package(Zephyr REQUIRED HINTS $ENV{ZEPHYR_BASE})
project(oevm_layoutdump)
# tools/dump_layout.c is `int main(void)` and links nothing — it only prints
# sizeof/offsetof for the TARGET ABI. Compiling it as the Zephyr app IS the test.
#
# Deliberately does NOT plumb the five OEVM_* env knobs that zephyr/CMakeLists.txt
# forwards: they are all `if(DEFINED ENV{...})` there, and dump_layout.c needs only
# oevm.h's struct declarations to compute sizeof/offsetof. Sizes and offsets do not
# depend on the heap/cache tunables, so a bare compile yields the same layout.
target_sources(app PRIVATE ${CMAKE_CURRENT_SOURCE_DIR}/../../tools/dump_layout.c)
# Beside dump_layout.c, never inside it: that file is shared with the host gate.
# src/console_prep.c unbuffers stdout and prints a printk marker — see its header.
target_sources(app PRIVATE ${CMAKE_CURRENT_SOURCE_DIR}/src/console_prep.c)
target_include_directories(app PRIVATE ${CMAKE_CURRENT_SOURCE_DIR}/../../src)
```

## prj.conf
```kconfig
# Throwaway app: compiles tools/dump_layout.c for the ESP32 ABI and prints the
# struct layout JSON over the console. Its output is banked as
# zephyr/layout-esp32.json and fed to the Model B bake as --layout.
#
# Regenerate only when a struct in src/ or the toolchain changes.
CONFIG_SERIAL=y
CONFIG_UART_CONSOLE=y
CONFIG_STDOUT_CONSOLE=y
CONFIG_PICOLIBC=y
# rev-1.0 silicon: without this the bootloader HALTS at soc_init and main never runs.
# (Same opt-in as prj_esp32.conf — the bench board is an ESP32-D0WDQ6 rev v1.0.)
CONFIG_ESP32_USE_UNSUPPORTED_REVISION=y
```

## prj_dongle.conf
```kconfig
# layoutdump for the nRF52840 DONGLE (PCA10059) ABI. Throwaway app: compiles
# tools/dump_layout.c and prints the struct layout JSON over the console. Output is
# banked as zephyr/layout-nrf52840.json and fed to the Model B bake as --layout.
# rete#281 item 2 — until this file existed, nRF was Model A only, which is the
# ~4.9 GB / ~50 min cc1 bake run.sh:426 warns has OOM-killed a desktop.
#
# ONE layout serves both nRF boards. The DK and the dongle are the same part, the
# same arm-zephyr-eabi toolchain and the same ABI; the differences run.sh encodes
# between them (console, trigger pin, flash method) are Kconfig and devicetree, and
# a struct offset cannot depend on any of them. The dongle is the one that got the
# run because it is the board on the bench, not because the ABI is the dongle's.
#
# --- Console: SoC USB-CDC ACM, and the capture depends on it ---------------------
#
# The dongle has NO debugger and no VCOM: the console is the SoC's own USB-CDC,
# published by this application. The block below is Zephyr's supported recipe and
# CDC_ACM_SERIAL_INITIALIZE_AT_BOOT is its load-bearing line — without it nothing
# ever starts USB and the app boots silently (prj_dongle_thread.conf's "Issue A",
# which read as a radio fault for two rungs).
#
# UART_LINE_CTRL=y IS WHY THIS CAPTURE IS NOT A RACE. dump_layout.c's main() prints
# once and returns, so an output printed before the host opens the port would be
# lost with no way to tell an empty capture from a broken one. With LINE_CTRL the
# first console write BLOCKS until a host opens the port and asserts DTR — so the
# JSON waits for the reader instead of the reader waiting for the JSON. Read it with
# pyserial dtr=True, never `cat`.
CONFIG_USB_DEVICE_STACK_NEXT=y
CONFIG_USBD_CDC_ACM_CLASS=y
CONFIG_USBD_CDC_ACM_WORKQUEUE=y
CONFIG_CDC_ACM_SERIAL_INITIALIZE_AT_BOOT=y
CONFIG_SERIAL=y
CONFIG_CONSOLE=y
CONFIG_UART_CONSOLE=y
CONFIG_UART_LINE_CTRL=y
CONFIG_STDOUT_CONSOLE=y
CONFIG_CBPRINTF_COMPLETE=y

# A fatal error must leave EVIDENCE rather than reboot into a fresh boot that looks
# healthy — the failure mode that hid the dongle's silence for two rungs.
CONFIG_RESET_ON_FATAL_ERROR=n

# picolibc, as every other dongle image here uses. The libc choice cannot move a
# struct offset (these are oevm's own structs, no libc type among them), but the
# layout is captured to be USED by the dongle build, so it is captured under the
# dongle build's libc rather than a different one.
CONFIG_PICOLIBC=y
CONFIG_PICOLIBC_IO_FLOAT=y
CONFIG_CBPRINTF_FP_SUPPORT=y
CONFIG_FPU=y

# No networking, no NVS, no settings: this app prints and stops. That is also why it
# needs no pm_static_dongle.yml — it has no settings_storage partition to collide
# with the Open Bootloader's pages, which is the only reason that file exists.
CONFIG_MAIN_STACK_SIZE=2048

# BOOT_DELAY IS WHAT MAKES THIS CAPTURE REPRODUCIBLE, and it was earned by a failed
# run. dump_layout.c prints ONCE from main() and returns — it is shared with the host
# gate, which regenerates the layout every nsl suite run, so it must not be given a
# print loop. On the dongle the console does not exist until USB enumerates after the
# post-DFU reset, and the first attempt captured NOTHING: main had run, printed into a
# console with no host, and returned, ~4 s before a reader could open the port.
# UART_LINE_CTRL does not save this — it gates writes through the console API the VM's
# platform_console_write uses, not printf's path out of a bare Zephyr app.
#
# 20 s is the window to open the port after the flash resets the board. An empty
# capture is therefore now a real fault, not a mistimed one.
CONFIG_BOOT_DELAY=20000
```

## prj_feather_rp2040.conf
```kconfig
# layoutdump for the RP2040 (Adafruit Feather RP2040, out-of-tree board under
# zephyr/boards/adafruit/) ABI. rete#302's REHEARSAL: the Pico 2s were in the post,
# and every step of the RP2 loop but the core itself — BOOTSEL/UF2 on this desktop,
# the uart0 adapter on GP0/GP1, this capture, TimerNode under the pico-sdk HAL —
# is the same on both parts. Output banked as zephyr/layout-rp2040.json.
#
#   west build -b adafruit_feather_rp2040 -d build-feather zephyr/layoutdump \
#     -- -DCONF_FILE=prj_feather_rp2040.conf
#
# A Cortex-M0+ under the same arm-zephyr-eabi ILP32 rules as the nRF's M4F and the
# Pico 2's M33 — identical to those is the expectation; the file is still this
# target's own (see prj_rpi_pico2.conf). Same console shape as the Pico 2: uart0 on
# an external adapter that stays enumerated across resets.
CONFIG_SERIAL=y
CONFIG_UART_CONSOLE=y
CONFIG_STDOUT_CONSOLE=y
CONFIG_CBPRINTF_COMPLETE=y
CONFIG_PICOLIBC=y
CONFIG_PICOLIBC_IO_FLOAT=y
CONFIG_CBPRINTF_FP_SUPPORT=y
# No CONFIG_FPU: the M0+ has none (and the option is not selectable for it).
CONFIG_MAIN_STACK_SIZE=2048
CONFIG_BOOT_DELAY=3000
```

## prj_rpi_pico2.conf
```kconfig
# layoutdump for the RP2350 (Raspberry Pi Pico 2, rpi_pico2/rp2350a/m33) ABI.
# Throwaway app: compiles tools/dump_layout.c and prints the struct layout JSON
# over the console. Output is banked as zephyr/layout-rp2350.json and fed to the
# Model B bake as --layout. rete#302 Task 2.
#
# Build (same west workspace as the C6 — ~/zephyr-esp32, NOT ~/ncs):
#   west build -b rpi_pico2/rp2350a/m33 -d build-layoutdump-pico2 zephyr/layoutdump \
#     -- -DCONF_FILE=prj_rpi_pico2.conf
#
# A layout must be dumped per target because you cannot know it matches until you
# look. layout-esp32c6.json and layout-nrf52840.json came out byte-identical (Xtensa,
# RV32 and a Cortex-M4F under the same ILP32 GCC rules), and this M33 build uses the
# same arm-zephyr-eabi toolchain the nRF does — so identical is the EXPECTED outcome,
# and run.sh still refuses to bake without this target's own file (the -m32 proxy was
# found unsafe once, review/program-sequence.md).
#
# Console: uart0 (GP0 TX / GP1 RX), the board default. The Pico 2 has NO on-board
# USB-UART bridge, so uart0 rides whatever adapter is wired to those pins — and that
# adapter stays enumerated across the board's resets, which is what makes this
# capture the C6's shape (open the reader first, then flash) rather than the
# dongle's (BOOT_DELAY + LINE_CTRL to wait for a USB host). If the desk has only a
# USB cable, the dongle recipe (prj_dongle.conf) is the fallback: USB-CDC via the
# rp2350's usbd node — a second conf, not an edit to this one.
CONFIG_SERIAL=y
CONFIG_UART_CONSOLE=y
CONFIG_STDOUT_CONSOLE=y
CONFIG_CBPRINTF_COMPLETE=y

# No CONFIG_RESET_ON_FATAL_ERROR=n here, unlike prj_dongle.conf: that symbol is
# NCS's (sdk-nrf), not upstream Zephyr's, and this tree aborts the build on an
# unknown symbol. Upstream's default fatal handler halts, which is the outcome the
# dongle line was buying.

# picolibc, as the node image will use. The libc cannot move an oevm struct offset,
# but the layout is captured under the libc the consumer builds with.
CONFIG_PICOLIBC=y
CONFIG_PICOLIBC_IO_FLOAT=y
CONFIG_CBPRINTF_FP_SUPPORT=y
# Hardware float ON, as on the nRF52840 (M4F) and Xtensa ESP32 — the C6 is the odd
# one out with none. struct Float's 8-byte double alignment is an ABI fact either
# way; -mfloat-abi=hard is what the node image builds with, so capture under it.
CONFIG_FPU=y

CONFIG_MAIN_STACK_SIZE=2048

# A short window between the post-flash reset and main(): with a UART adapter the
# reader is already open, so this is insurance against a reader started late, not a
# gate. The dongle needed 20 s because its console did not EXIST until USB enumerated.
CONFIG_BOOT_DELAY=3000
```

## prj_rpi_pico2_usb.conf
```kconfig
# layoutdump for the RP2350 over its OWN USB — the no-solder capture.
#
# prj_rpi_pico2.conf is the UART capture (uart0 on GP0/GP1 through an adapter) and
# names this file as its fallback: "if the desk has only a USB cable, the dongle
# recipe is the fallback — a second conf, not an edit to this one". This is that
# file. Same ABI, same toolchain, same dump_layout.c; the ONLY difference is where
# the bytes come out, and a struct offset cannot depend on that. Written 2026-09-21
# for rete#302 on a Waveshare RP2350-Zero (an RP2350A like the Pico 2, 2 MB flash,
# native USB on its USB-C; no GP0/GP1 adapter soldered yet).
#
# The console is the RP2350's usbd node publishing a CDC-ACM port: Zephyr v4.2's
# udc_rpi_pico.c (default y once the node is okay, which rpi_pico2.dtsi does) under
# USB_DEVICE_STACK_NEXT. Everything below is prj_dongle.conf's block verbatim and
# for the dongle's reasons — read that file's header, it was earned by two empty
# captures. In one line each:
#   CDC_ACM_SERIAL_INITIALIZE_AT_BOOT  nothing else starts USB; without it the app
#                                      boots silently (prj_dongle_thread.conf Issue A)
#   UART_LINE_CTRL                     the first console write BLOCKS until a host
#                                      asserts DTR — the JSON waits for the reader
#   hw-flow-control (usb-console.overlay)  the CDC ring buffer DISCARDS under burst
#                                      without it; the dump is one ~3.5 KB burst
#   BOOT_DELAY=20000                   the console does not EXIST until USB
#                                      enumerates after the post-UF2 reset
# Build (this file + the overlay, from the ~/zephyr-esp32 venv):
#   west build -b rpi_pico2/rp2350a/m33 -d build-pico2-usb . -- \
#     -DCONF_FILE=prj_rpi_pico2_usb.conf -DEXTRA_DTC_OVERLAY_FILE=usb-console.overlay
# Capture: hold BOOT, plug in (or BOOT + tap RUN on the Zero) → 2e8a:000f mounts as
# RP2350 → copy build-pico2-usb/zephyr/zephyr.uf2 onto it → the board resets and
# re-enumerates as a CDC port (a NEW ttyACM, the ROM's disk is gone) → within 20 s:
#   python3 capture.py /dev/serial/by-id/usb-ZEPHYR_*-if00 ../layout-rp2350.json \
#     --ref ../layout-esp32c6.json
CONFIG_USB_DEVICE_STACK_NEXT=y
CONFIG_USBD_CDC_ACM_CLASS=y
CONFIG_USBD_CDC_ACM_WORKQUEUE=y
CONFIG_CDC_ACM_SERIAL_INITIALIZE_AT_BOOT=y
CONFIG_SERIAL=y
CONFIG_CONSOLE=y
CONFIG_UART_CONSOLE=y
CONFIG_UART_LINE_CTRL=y
CONFIG_STDOUT_CONSOLE=y
CONFIG_CBPRINTF_COMPLETE=y

# No CONFIG_RESET_ON_FATAL_ERROR=n: that symbol is NCS's, and upstream aborts the
# build on an unknown symbol (prj_rpi_pico2.conf). Upstream's default halts anyway.

# picolibc + hard float, exactly as prj_rpi_pico2.conf — the layout is captured under
# the libc and float ABI the node image builds with.
CONFIG_PICOLIBC=y
CONFIG_PICOLIBC_IO_FLOAT=y
CONFIG_CBPRINTF_FP_SUPPORT=y
CONFIG_FPU=y

CONFIG_MAIN_STACK_SIZE=2048

CONFIG_BOOT_DELAY=20000
```

## usb-console.overlay
```dts
/*
 * oevm/zephyr/layoutdump/usb-console.overlay — console on the SoC's own USB.
 *
 * Passed explicitly (-DEXTRA_DTC_OVERLAY_FILE=usb-console.overlay) with
 * prj_rpi_pico2_usb.conf, and deliberately NOT named after a board: a file in
 * boards/<board>.overlay is applied to EVERY build for that board, which would
 * silently move the UART capture's console onto USB too. The dongle's overlay
 * lives under boards/ because the dongle has no other console; the RP2350 has two.
 *
 * hw-flow-control is the dongle's finding (boards/nrf52840dongle_nrf52840.overlay):
 * usbd_cdc_acm.c DISCARDS bytes when its ring buffer is full unless flow_ctrl is
 * set, in which case it sleeps 1 ms and retries. The dump is one ~3.5 KB burst.
 * DO NOT copy this to a node image — a blocking console on an unattended board
 * is a VM wedge; here a host is attached by construction.
 */
/ {
	chosen {
		zephyr,console = &usb_console_uart;
		zephyr,shell-uart = &usb_console_uart;
	};
};

&zephyr_udc0 {
	usb_console_uart: usb_console_uart {
		compatible = "zephyr,cdc-acm-uart";
		hw-flow-control;
	};
};
```

## boards/nrf52840dongle_nrf52840.overlay
```dts
/*
 * oevm/zephyr/layoutdump — nRF52840 dongle: make the console LOSSLESS.
 *
 * The capture is ~3.5 KB emitted in one burst by dump_layout.c, and the dongle's
 * console is the SoC USB-CDC. Without this property the second capture attempt
 * came back TRUNCATED AND INTERLEAVED — 2176 of ~3500 bytes, whole runs missing
 * from the middle — which reads like a corrupt dump rather than a dropped one.
 *
 * zephyr/subsys/usb/device_next/class/usbd_cdc_acm.c:1004 is the mechanism:
 *
 *     if (k_is_in_isr() || !data->flow_ctrl) {
 *             LOG_WRN_ONCE("Ring buffer full, discard data");
 *             break;          <- the byte is DISCARDED
 *     }
 *     k_msleep(1);            <- with flow_ctrl: wait for the host to drain
 *
 * and .flow_ctrl comes from this devicetree property (same file, :1368). So the
 * choice is between a console that drops under burst and one that blocks — and
 * for a throwaway capture app that must emit an exact artifact, blocking is the
 * only correct answer.
 *
 * DO NOT copy this to the NODE image without thinking. prj_dongle_thread.conf's
 * console block warns that platform_console_write() must never be able to wedge
 * the VM on a board whose console has no reader — and a BLOCKING poll_out on an
 * unattended dongle is precisely that wedge. Dropping is the safer default there;
 * losslessness is worth its cost only here, where a host is attached by
 * construction and the app's whole purpose is the bytes.
 */
&board_cdc_acm_uart {
	hw-flow-control;
};
```

## src/console_prep.c
```c
/* oevm/zephyr/layoutdump/src/console_prep.c — make the dump reach the console.
 *
 * tools/dump_layout.c owns main(), prints the layout JSON once with printf, and
 * returns. It is SHARED with the host gate (the nsl suite rebuilds it and
 * regenerates the host layout every run), so it must not grow a print loop, a
 * flush, or a board-shaped #ifdef. Anything a target needs has to be added
 * BESIDE it — hence a SYS_INIT here rather than an edit there.
 *
 * Two things, and the marker is deliberate:
 *
 *   setvbuf: src/main.c:1801 unbuffers stdout and stderr on every board and says
 *   why — "nothing unbuffers stderr, so without this a failing blob can die
 *   silently". main() returning without exit() never flushes picolibc's buffer,
 *   so a fully-buffered ~3 KB of JSON is emitted into memory and lost. The ESP32
 *   dumps predate this file and worked, so buffering is a HYPOTHESIS about the
 *   dongle, not a known cause.
 *
 *   printk: the discriminator for that hypothesis. printk bypasses stdio
 *   entirely and writes straight to the console driver, so the next capture
 *   separates three outcomes that all look identical as an empty file today —
 *   marker + JSON (stdio buffering was it), marker alone (the stdio path is
 *   broken and buffering was not the cause), neither (the CDC endpoint is
 *   dropping TX, e.g. DTR gating, and no stdio change can help).
 */
#include <zephyr/init.h>
#include <zephyr/sys/printk.h>
#include <zephyr/device.h>
#include <zephyr/drivers/uart.h>
#include <zephyr/kernel.h>
#include <stdio.h>

static int layoutdump_console_prep(void)
{
    /* A BOUNDED wait for the host, and the bound is the point. On a USB-CDC
       console the driver can drop TX until the host opens the port and asserts
       DTR, which is a third way this capture can come back empty — and it is
       indistinguishable from the other two in the output file. Waiting reports
       what was actually observed instead: dtr=1 means the host was there and the
       gate is not the story; dtr=0 after the full wait names the gate directly.
       Bounded at 10 s (inside BOOT_DELAY's 20 s window) so a board with no
       reader still boots, prints into the void and stops, rather than hanging
       here forever looking like a dead image. */
    const struct device *con = DEVICE_DT_GET(DT_CHOSEN(zephyr_console));
    uint32_t dtr = 0;
    int waited = 0;

    while (waited < 10000) {
        if (uart_line_ctrl_get(con, UART_LINE_CTRL_DTR, &dtr) == 0 && dtr) {
            break;
        }
        k_sleep(K_MSEC(100));
        waited += 100;
    }

    setvbuf(stdout, NULL, _IONBF, 0);
    setvbuf(stderr, NULL, _IONBF, 0);
    printk("layoutdump: console up, stdout unbuffered, dtr=%u after %dms\n",
           (unsigned)dtr, waited);
    return 0;
}

/* APPLICATION level: after the console and the USB device stack are initialized
   (CDC_ACM_SERIAL_INITIALIZE_AT_BOOT), and before the main thread runs. */
SYS_INIT(layoutdump_console_prep, APPLICATION, 99);
```
